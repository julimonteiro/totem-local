## config/west.yml
```yaml
manifest:
  remotes:
    - name: zmkfirmware
      url-base: https://github.com/zmkfirmware
  projects:
    - name: zmk
      remote: zmkfirmware
      revision: 7823a43f627e5a14fc92238783480d52ae5ed1ce
      import: app/west.yml
  self:
    path: config
```
